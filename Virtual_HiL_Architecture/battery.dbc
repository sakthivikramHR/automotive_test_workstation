VERSION ""
NS_ :

BS_:
BU_: BMS TESTER
BO_ 500 BMS_Status: 8 BMS
 SG_ BatteryTemp : 0|8@1+ (1,0) [0|255] "degC" TESTER
 SG_ BatteryVoltage : 8|16@1+ (0.001,0) [0|65.535] "V" TESTER
